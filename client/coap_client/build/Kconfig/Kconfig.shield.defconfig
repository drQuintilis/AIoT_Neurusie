## client/coap_client/build/Kconfig/boards/Kconfig.defconfig.tmp
```kconfig
# Load Zephyr board defconfig descriptions.
osource "/home/daniel/ncs/330rc2/zephyr/boards/nordic/nrf54l15dk/Kconfig.defconfig"
```

## client/coap_client/build/coap_client/Kconfig/boards/Kconfig.sysbuild
```kconfig
# Load Sysbuild board Kconfig descriptions.
osource "/home/daniel/ncs/330rc2/zephyr/boards/nordic/nrf54l15dk/Kconfig.sysbuild"
```

## server/coap_server/build/Kconfig/boards/Kconfig.defconfig
```kconfig
# Load Zephyr board defconfig descriptions.
osource "/home/daniel/ncs/330rc2/zephyr/boards/nordic/nrf7002dk/Kconfig.defconfig"
```

## server/coap_server/build/coap_server/Kconfig/boards/Kconfig.tmp
```kconfig
# Load Zephyr board Kconfig descriptions.
osource "/home/daniel/ncs/330rc2/zephyr/boards/nordic/nrf7002dk/Kconfig"
```

## server/coap_server/build/ipc_radio/Kconfig/boards/Kconfig.nrf7002dk
```kconfig
# Load board Kconfig descriptions.
osource "/home/daniel/ncs/330rc2/zephyr/boards/nordic/nrf7002dk/Kconfig.nrf7002dk"
```
